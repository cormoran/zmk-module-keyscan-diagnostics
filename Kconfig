## Kconfig
```kconfig
config ZMK_KEYSCAN_DIAGNOSTICS
    bool "Enable keyscan diagnostics feature"
    help
      Enable keyscan diagnostics module for debugging keyboard matrix issues.
      This module helps identify chattering, insufficient soldering, and other
      keyscan problems by monitoring key events and GPIO states.

if ZMK_KEYSCAN_DIAGNOSTICS

config ZMK_KEYSCAN_DIAGNOSTICS_STUDIO_RPC
    bool "Enable keyscan diagnostics custom Studio RPC"
    depends on ZMK_STUDIO
    help
      Enable custom Studio RPC protocol for keyscan diagnostics.
      This allows communication with the web UI for real-time diagnostics.

config ZMK_KEYSCAN_DIAGNOSTICS_EVENT_BUFFER_SIZE
    int "Maximum number of key events to store"
    default 100
    help
      Maximum number of recent key events to store in the circular buffer.
      Larger values use more RAM but provide more diagnostic history.

config ZMK_KEYSCAN_DIAGNOSTICS_CHATTER_THRESHOLD_MS
    int "Default chattering detection threshold in milliseconds"
    default 50
    help
      Default interval threshold for detecting chattering.
      Events occurring faster than this interval are considered chattering.

endif
```

## tests/zmk-config/boards/shields/my_awesome_keyboard_charlieplex/Kconfig.defconfig
```kconfig
if SHIELD_MY_AWESOME_KEYBOARD_CHARLIEPLEX

config ZMK_KEYBOARD_NAME
    default "MAK-CP"

config ZMK_BLE
    def_bool n

config SETTINGS
    def_bool n

config ZMK_KEYSCAN_DIAGNOSTICS
    default y

endif
```

## tests/zmk-config/boards/shields/my_awesome_keyboard_charlieplex/Kconfig.shield
```kconfig
config SHIELD_MY_AWESOME_KEYBOARD_CHARLIEPLEX
    def_bool $(shields_list_contains,my_awesome_keyboard_charlieplex)
```
